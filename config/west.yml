## config/west.yml
```yaml
manifest:
  remotes:
    - name: zmkfirmware
      url-base: https://github.com/zmkfirmware
    # nice_oled
    - name: mctechnology17
      url-base: https://github.com/mctechnology17
  projects:
    # nice_oled
    - name: zmk-nice-oled
      remote: mctechnology17
      revision: main
    - name: eyelash_sofle
      url: https://github.com/a741725193/zmk-sofle
      revision: main
    - name: zmk
      remote: zmkfirmware
      revision: v0.3.0
      import: app/west.yml
  self:
    path: boards
```
